## boards/arm/zest_core_nrf5340/Kconfig.board
```kconfig
# ZEST_CORE_NRF5340 NRF5340 board configuration

# Copyright (c) 2019-2020 Nordic Semiconductor ASA
# SPDX-License-Identifier: Apache-2.0

if SOC_NRF5340_CPUAPP_QKAA

config BOARD_ZEST_CORE_NRF5340_NRF5340_CPUAPP
	bool "ZEST_CORE_NRF5340 nRF5340 Application MCU"

config BOARD_ZEST_CORE_NRF5340_NRF5340_CPUAPP_NS
	bool "ZEST_CORE_NRF5340 nRF5340 Application MCU non-secure"

endif # SOC_NRF5340_CPUAPP_QKAA

config BOARD_ZEST_CORE_NRF5340_NRF5340_CPUNET
	bool "ZEST_CORE_NRF5340 NRF5340 Network MCU"
	depends on SOC_NRF5340_CPUNET_QKAA
```

## boards/catie/zest_core_nrf5340/Kconfig
```kconfig
# ZEST_CORE_NRF5340 board configuration

# Copyright (c) 2019 - 2021 Nordic Semiconductor ASA
# SPDX-License-Identifier: Apache-2.0

if BOARD_ZEST_CORE_NRF5340_NRF5340_CPUAPP || BOARD_ZEST_CORE_NRF5340_NRF5340_CPUAPP_NS

config DOMAIN_CPUNET_BOARD
	string
	default "zest_core_nrf5340/nrf5340/cpunet"
	help
	  The board which will be used for CPUNET domain when creating a multi
	  image application where one or more images should be located on
	  another board. For example hci_ipc on the nRF5340_cpunet for
	  Bluetooth applications.

endif #  BOARD_ZEST_CORE_NRF5340_NRF5340_CPUAPP || BOARD_ZEST_CORE_NRF5340_NRF5340_CPUAPP_NS

config DOMAIN_CPUAPP_BOARD
	string
	default "zest_core_nrf5340/nrf5340/cpuapp"
	depends on BOARD_ZEST_CORE_NRF5340_NRF5340_CPUNET
	help
	  The board which will be used for CPUAPP domain when creating a multi
	  image application where one or more images should be located on
	  another board.
```

## boards/catie/zest_core_nrf5340/Kconfig.zest_core_nrf5340
```kconfig
# ZEST_CORE_NRF5340 NRF5340 board configuration

# Copyright (c) 2019-2020 Nordic Semiconductor ASA
# SPDX-License-Identifier: Apache-2.0

config BOARD_ZEST_CORE_NRF5340
	select SOC_NRF5340_CPUAPP_QKAA if BOARD_ZEST_CORE_NRF5340_NRF5340_CPUAPP
	select SOC_NRF5340_CPUAPP_QKAA if BOARD_ZEST_CORE_NRF5340_NRF5340_CPUAPP_NS
	select SOC_NRF5340_CPUNET_QKAA if BOARD_ZEST_CORE_NRF5340_NRF5340_CPUNET
```

## boards/catie/zest_core_nrf5340/board.yml
```yaml
board:
  name: zest_core_nrf5340
  full_name: Zest_Core_nRF5340
  vendor: catie
  socs:
    - name: 'nrf5340'
      variants:
        - name: 'ns'
          cpucluster: 'cpuapp'
```
