/*
 * Copyright (c) 2020 Nordic Semiconductor ASA
 *
 * SPDX-License-Identifier: Apache-2.0
 */

/dts-v1/;
#include <nordic/nrf5340_cpuappns_qkaa.dtsi>
#include "nrf5340_cpuapp_common.dtsi"
#include "sixtron_connector.dtsi"

/ {
	model = "6TRON ZEST_CORE_NRF5340 NRF5340 Application";
	compatible = "nordic,zest-core-nrf5340-nrf5340-cpuapp";

	chosen {
		zephyr,sram = &sram0_ns_app;
		zephyr,flash = &flash0;
		zephyr,code-partition = &slot0_ns_partition;
	};
};

&uart1 {
	status = "disabled";
};
